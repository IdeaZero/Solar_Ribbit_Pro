## Firmware/Firmware/led_strip/build/Kconfig/boards/Kconfig.defconfig
```kconfig
# Load Zephyr board defconfig descriptions.
osource "/home/parth/ncs/v2.8.0/zephyr/boards/nordic/nrf9151dk/Kconfig.defconfig"
```

## Firmware/Firmware/led_strip/build/led_strip/Kconfig/Kconfig.shield
```kconfig
osource "/home/parth/Desktop/nrf9151/led_strip/boards/shields/*/Kconfig.shield"
osource "/home/parth/ncs/v2.8.0/nrf/boards/shields/*/Kconfig.shield"
```

## Firmware/Firmware/led_strip/build/led_strip/Kconfig/Kconfig.shield.defconfig
```kconfig
osource "/home/parth/Desktop/nrf9151/led_strip/boards/shields/*/Kconfig.defconfig"
osource "/home/parth/ncs/v2.8.0/nrf/boards/shields/*/Kconfig.defconfig"
```

## Firmware/Firmware/led_strip/build/led_strip/Kconfig/arch/Kconfig
```kconfig
# Load Zephyr Arch Kconfig descriptions.
osource "/home/parth/ncs/v2.8.0/zephyr/arch/x86/Kconfig"
osource "/home/parth/ncs/v2.8.0/zephyr/arch/xtensa/Kconfig"
osource "/home/parth/ncs/v2.8.0/zephyr/arch/sparc/Kconfig"
osource "/home/parth/ncs/v2.8.0/zephyr/arch/riscv/Kconfig"
osource "/home/parth/ncs/v2.8.0/zephyr/arch/posix/Kconfig"
osource "/home/parth/ncs/v2.8.0/zephyr/arch/nios2/Kconfig"
osource "/home/parth/ncs/v2.8.0/zephyr/arch/mips/Kconfig"
osource "/home/parth/ncs/v2.8.0/zephyr/arch/arm64/Kconfig"
osource "/home/parth/ncs/v2.8.0/zephyr/arch/arm/Kconfig"
osource "/home/parth/ncs/v2.8.0/zephyr/arch/arc/Kconfig"
```

## Firmware/Firmware/led_strip/build/led_strip/Kconfig/boards/Kconfig
```kconfig
# Load Zephyr board Kconfig descriptions.
osource "/home/parth/ncs/v2.8.0/zephyr/boards/nordic/nrf9151dk/Kconfig"
```
